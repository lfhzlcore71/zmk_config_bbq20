## config/bbq20/Kconfig.board
```kconfig
# Copyright (c) 2025 XixiLee-boom
# SPDX-License-Identifier: MIT

config BOARD_BBQ20
    bool "bbq20"
    depends on SOC_NRF52840_QIAA
```

## config/west.yml
```yaml
manifest:
  remotes:
    - name: zmkfirmware
      url-base: https://github.com/zmkfirmware
    - name: daliben123
      url-base: https://github.com/daliben123
  projects:
    - name: zmk
      remote: daliben123
      revision: bbkeyboard_tp
      import: app/west.yml
  self:
    path: config
```
